## safety-app-layer/conf/layer.conf
```bitbake
# We have a conf and classes directory, add to BBPATH
BBPATH .= ":${LAYERDIR}"

# We have recipes-* directories, add to BBFILES
BBFILES += "${LAYERDIR}/recipes-*/*/*.bb \
            ${LAYERDIR}/recipes-*/*/*.bbappend"

BBFILE_COLLECTIONS += "pipe-demo"
BBFILE_PATTERN_pipe-demo = "^${LAYERDIR}/"
BBFILE_PRIORITY_pipe-demo = "6"

LAYERDEPENDS_pipe-demo = "core"
LAYERSERIES_COMPAT_pipe-demo = "dunfell"
```
